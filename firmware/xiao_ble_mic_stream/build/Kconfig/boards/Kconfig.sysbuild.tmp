## firmware/xiao_ble_mic_stream/build/Kconfig/boards/Kconfig.sysbuild.tmp
```kconfig
# Load Sysbuild board Kconfig descriptions.
osource "/opt/nordic/ncs/v3.3.0/zephyr/boards/seeed/xiao_ble/Kconfig.sysbuild"
```

## firmware/xiao_ble_mic_stream/build/xiao_ble_mic_stream/Kconfig/boards/Kconfig
```kconfig
# Load Zephyr board Kconfig descriptions.
osource "/opt/nordic/ncs/v3.3.0/zephyr/boards/seeed/xiao_ble/Kconfig"
```
